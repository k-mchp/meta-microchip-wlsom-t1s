## conf/layer.conf
```bitbake
# We have a conf and classes directory, add to BBPATH
BBPATH .= ":${LAYERDIR}"

# We have recipes-* directories, add to BBFILES
BBFILES += "${LAYERDIR}/recipes-*/*/*.bb \
            ${LAYERDIR}/recipes-*/*/*.bbappend"

BBFILE_COLLECTIONS += "meta-microchip-wlsom-t1s"
BBFILE_PATTERN_meta-microchip-wlsom-t1s = "^${LAYERDIR}/"
BBFILE_PRIORITY_meta-microchip-wlsom-t1s = "11"

LAYERDEPENDS_meta-microchip-wlsom-t1s = "core"
LAYERSERIES_COMPAT_meta-microchip-wlsom-t1s = "dunfell"
```
